## prj.conf
```kconfig
# nRF54 Soil Moisture Sensor - Debug Configuration
# Development build with full logging

# Application features
CONFIG_APP_MEASUREMENT_INTERVAL_SEC=10

# Device-specific product config
CONFIG_BT_DEVICE_NAME="Humid"
CONFIG_CHIP_DEVICE_TYPE=775
CONFIG_CHIP_DEVICE_VENDOR_ID=65521
CONFIG_CHIP_DEVICE_VENDOR_NAME="Dan Stiner"
CONFIG_CHIP_DEVICE_PRODUCT_ID=32768
CONFIG_CHIP_DEVICE_PRODUCT_NAME="Humidity Sensor"
CONFIG_CHIP_PROJECT_CONFIG="src/chip_project_config.h"

# Enable sensors and I2C bus
CONFIG_SENSOR=y
CONFIG_I2C=y
CONFIG_PINCTRL=y

CONFIG_FLASH=y

CONFIG_GPIO=y
CONFIG_SPI=y
CONFIG_SPI_NOR=y
CONFIG_SPI_NOR_SFDP_DEVICETREE=y
CONFIG_SPI_NOR_FLASH_LAYOUT_PAGE_SIZE=4096
CONFIG_NORDIC_QSPI_NOR=n

# Enable CHIP (Matter)
CONFIG_CHIP=y
CONFIG_CHIP_COMMISSIONABLE_DEVICE_TYPE=y
CONFIG_CHIP_ENABLE_PAIRING_AUTOSTART=y
CONFIG_CHIP_LIB_SHELL=y
CONFIG_CHIP_MAX_ACTIVE_DEVICES=1
CONFIG_CHIP_PERSISTENT_SUBSCRIPTIONS=y
CONFIG_CHIP_ROTATING_DEVICE_ID=y

# Enable OTA Requestor
CONFIG_CHIP_OTA_REQUESTOR=y

CONFIG_STD_CPP17=y
CONFIG_THREAD_NAME=y
CONFIG_MPU_STACK_GUARD=y

# Enable Intermittently Connected Device support,
# with Long Idle Time to reduce power usage
CONFIG_CHIP_ENABLE_ICD_SUPPORT=y
CONFIG_CHIP_ICD_LIT_SUPPORT=y

# Debug: Faster polling for OTA testing
CONFIG_CHIP_ICD_SLOW_POLL_INTERVAL=30000

# OpenThread shell for debugging
CONFIG_OPENTHREAD_SHELL=y
CONFIG_SHELL_STACK_SIZE=4096
CONFIG_SHELL_BACKEND_SERIAL_RX_RING_BUFFER_SIZE=512

# GRTC timer for wakeup from System OFF
CONFIG_NRF_GRTC_TIMER=y

# Hardware info for reset cause detection
CONFIG_HWINFO=y

# Power Management
CONFIG_PM=y
CONFIG_PM_DEVICE=y
CONFIG_PM_DEVICE_RUNTIME=y

# System Off (deep sleep)
CONFIG_POWEROFF=y

# Serial/UART power management
# CONFIG_UART_USE_RUNTIME_CONFIGURE=y
# CONFIG_UART_ASYNC_API=y

# Memory footprint
CONFIG_HEAP_MEM_POOL_SIZE=1024
CONFIG_IDLE_STACK_SIZE=256

# Console for debugging
CONFIG_CONSOLE=y
CONFIG_UART_CONSOLE=y

# Configure UART async logging and shell
CONFIG_LOG=y
CONFIG_LOG_MODE_DEFERRED=y
CONFIG_LOG_PROCESS_THREAD_STACK_SIZE=1024
CONFIG_LOG_BUFFER_SIZE=4096
CONFIG_LOG_FUNC_NAME_PREFIX_DBG=n
CONFIG_SHELL=y
CONFIG_SHELL_LOG_BACKEND=y
CONFIG_MATTER_LOG_LEVEL_INF=y

# CHIP size optimizations
CONFIG_CHIP_LOG_SIZE_OPTIMIZATION=y

# Reduce radio TX power
CONFIG_OPENTHREAD_DEFAULT_TX_POWER=-4
CONFIG_BT_CTLR_TX_PWR_MINUS_8=y

# Larger stack required during matter commisioning
CONFIG_MAIN_STACK_SIZE=8196
```

## src/sht4x.cpp
```c
#include "sht4x.h"

#include <zephyr/drivers/sensor/sht4x.h>
#include <zephyr/drivers/sensor.h>
#include <zephyr/logging/log.h>

LOG_MODULE_REGISTER(sht4x, CONFIG_CHIP_APP_LOG_LEVEL);

#if !DT_HAS_COMPAT_STATUS_OKAY(sensirion_sht4x)
#error "No sensirion,sht4x compatible node found in the device tree"
#endif

CHIP_ERROR Sht4x::Init()
{
	CHIP_ERROR err = CHIP_NO_ERROR;

	LOG_DBG("Initialize sensirion_sht4x");
	
	sht = DEVICE_DT_GET_ANY(sensirion_sht4x);

    if (!device_is_ready(sht))
    {
		// TODO handle failure more gracefully
        return CHIP_NO_ERROR;
    }


#if APP_SHT4X_USE_HEATER
	struct sensor_value heater_p;
	struct sensor_value heater_d;

	heater_p.val1 = CONFIG_SHT4X_HEATER_PULSE_POWER;
	heater_d.val1 = !!CONFIG_SHT4X_HEATER_PULSE_DURATION_LONG;
	sensor_attr_set(sht, SENSOR_CHAN_ALL, SENSOR_ATTR_SHT4X_HEATER_POWER, &heater_p);
	sensor_attr_set(sht, SENSOR_CHAN_ALL, SENSOR_ATTR_SHT4X_HEATER_DURATION, &heater_d);
#endif

	return err;
}

bool Sht4x::Ready()
{
	return device_is_ready(sht);
}

bool Sht4x::Read(int16_t &temperature, uint16_t &humidity)
{
	struct sensor_value temp, hum;
	int rc;

	rc = sensor_sample_fetch(sht);
	if (rc != 0) {
		LOG_ERR("Failed to fetch sample from SHT4X: %d", rc);
		return false;
	}

	rc = sensor_channel_get(sht, SENSOR_CHAN_AMBIENT_TEMP, &temp);
	if (rc != 0) {
		LOG_ERR("Failed to read SHT4X temperature: %d", rc);
		return false;
	}

	rc = sensor_channel_get(sht, SENSOR_CHAN_HUMIDITY, &hum);
	if (rc != 0) {
		LOG_ERR("Failed to read SHT4X humidity: %d", rc);
		return false;
	}

#if CONFIG_SHT4X_USE_HEATER
		/*
		 * Conditions in which it makes sense to activate the heater
		 * are application/environment specific.
		 *
		 * The heater should not be used above SHT4X_HEATER_MAX_TEMP (65 °C)
		 * as stated in the datasheet.
		 *
		 * The temperature data will not be updated here for obvious reasons.
		 **/
		if (hum.val1 > CONFIG_SHT4X_HEATER_HUMIDITY_THRESH &&
		    temp.val1 < SHT4X_HEATER_MAX_TEMP_C) {
			LOG_INF("Activating heater");

			if (sht4x_fetch_with_heater(sht)) {
				LOG_ERR("Failed to fetch sample from SHT4X device");
				return false;
			}

			sensor_channel_get(sht, SENSOR_CHAN_HUMIDITY, &hum);
		}
#endif

	// Convert to Matter format
	// Temperature: 0.01°C units
	temperature = (temp.val1 * 100) + (temp.val2 / 10000);

	// Humidity: 0.01% units (0-10000 = 0-100%)
	humidity = (hum.val1 * 100) + (hum.val2 / 10000);

	LOG_INF("Reading %d.%02d°C, %d.%02d%% RH",
		temp.val1, temp.val2 / 10000, hum.val1, hum.val2 / 10000);

	return true;
}
```
